## Kconfig
```kconfig
menu "tamp"
		
	config TAMP_32BIT
	bool "Use ESP-optimized code for compression"
	default y
	help
		Enables TAMP_32BIT (32-bit speed optimizations).
		On ESP32-S3, this also enables use of the chip's SIMD instructions ("PIE")
		for increased speed.
		
endmenu
```

## devices/espidf/sdkconfig.defaults
```kconfig
CONFIG_COMPILER_OPTIMIZATION_PERF=y
CONFIG_TAMP_ESP32=y
CONFIG_TAMP_ESP32_AUTO_RESET_TASK_WDT=y
CONFIG_ESP_TASK_WDT_INIT=n
```

## espidf/test/sdkconfig.defaults
```kconfig
# QEMU-specific configuration for Tamp tests

# Enable Tamp ESP32 optimizations
CONFIG_TAMP_ESP32=y

# Disable watchdog for QEMU testing
CONFIG_ESP_TASK_WDT_EN=n
CONFIG_ESP_INT_WDT=n

# Reduce logging for cleaner test output
CONFIG_LOG_DEFAULT_LEVEL_INFO=y

# QEMU settings
CONFIG_ESP_CONSOLE_UART_NUM=0
CONFIG_ESP_CONSOLE_UART_BAUDRATE=115200

# Minimal partition table
CONFIG_PARTITION_TABLE_SINGLE_APP=y
```
